#include <SPI.h>
#include <Wire.h>
#include <Adafruit_GFX.h>
#include <Adafruit_SH1106.h>
#include <Adafruit_BMP085.h>

#define OLED_RESET 4
Adafruit_SH1106 display(OLED_RESET);

Adafruit_BMP085 bmp;
#define SEALEVELPRESSURE_HPA (101500)
/*Pin initialize*/
//Motor
int motor1pin1 = 2;
int motor1pin2 = 3;
int ENA = 9; //pwm, motor 1 speed
int motor2pin1 = 4;
int motor2pin2 = 5;
int ENB = 10; //pwm, motor 2 speed
int motorSpeed0 = 00;
int motorSpeed1 = 10;
int motorSpeed2 = 20;
int motorSpeed3 = 30;
int motorSpeed4 = 40;
int motorSpeed5 = 50;
int motorSpeed6 = 60;
//BitMap Position
int xx = 0;
int yy = 0;
//Ultrasonic
const int echoPin = 6; // Echo Pin of Ultrasonic Sensor
const int trigPin = 7; // Trigger Pin of Ultrasonic Sensor
/*Pin initialize*/
float simpweadiff, curpressure, pweather, curalt, temp;
/*BitMap Image*/
const unsigned char PROGMEM autobreak [] = {0x00, 0x00, 0x00, 0x00, 0x00, 0x00, 0x00, 0x00, 0x00, 0x00, 0x00, 0x00, 0x00,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 0x00, 0x00};
/*BitMap Image*/


void setup() {
 //Display Control
  display.begin(SH1106_SWITCHCAPVCC, 0x3C);
 //BMP Control
  if (!bmp.begin()) {
      Serial.println("Could not find a valid BMP085 sensor, check wiring!");
      while (1) {}
    }
 //Motor Control
  pinMode(motor1pin1, OUTPUT);
  pinMode(motor1pin2, OUTPUT);
  pinMode(ENA, OUTPUT);
  pinMode(motor2pin1, OUTPUT);
  pinMode(motor2pin2, OUTPUT);
  pinMode(ENB, OUTPUT);
 //Ultrasonic Control
  Serial.begin(9600); // Starting Serial Communication
  pinMode(trigPin, OUTPUT); // initialising pin 7 as output
  pinMode(echoPin, INPUT); // initialising pin 6 as input
}



void loop() {
  //Ultrasonic
   long duration, cm;
 digitalWrite(trigPin, LOW);
 delayMicroseconds(2);
 digitalWrite(trigPin, HIGH);
 delayMicroseconds(10);
 digitalWrite(trigPin, LOW);
 duration = pulseIn(echoPin, HIGH); // using pulsin function to determine total time
 cm = microsecondsToCentimeters(duration); // calling method

   
  // Display
  display.clearDisplay();
  display.setTextSize(1);
  display.setTextColor(WHITE);
    
  display.setCursor(0,0);
  display.print("=====SMART TRUCK=====");
  
  display.setCursor(0,15);
  display.print("T=");
  temp=bmp.readTemperature();
  display.print(temp);
  display.println("*C ");
  
  /*Fan control by temperature*/
  
  display.setCursor(0,42);
  if(temp<=27)
   {
    display.print("Cooling Fan OFF");
    digitalWrite(motor1pin1, LOW);
    digitalWrite(motor1pin2, LOW);
    analogWrite(ENA,motorSpeed0);
     display.setCursor(0,55);
     display.print("> Wind Level 0%");
   }
  if((temp>27)&&(temp<=28))
    {
     display.print("Cooling Fan ON");
     digitalWrite(motor1pin1, HIGH);
     digitalWrite(motor1pin2, LOW);
     analogWrite(ENA,motorSpeed2);
     display.setCursor(0,55);
     display.print("> Wind Level 20%");
    }
  if((temp>28)&&(temp<=29))
    {
     display.print("Cooling Fan ON");
     digitalWrite(motor1pin1, HIGH);
     digitalWrite(motor1pin2, LOW);
     analogWrite(ENA,motorSpeed3);
     display.setCursor(0,55);
     display.print("> Wind Level 40%");
    }
  if(temp>29)
    {
     display.print("Cooling Fan ON");
     digitalWrite(motor1pin1, HIGH);
     digitalWrite(motor1pin2, LOW);
     analogWrite(ENA,motorSpeed4);
     display.setCursor(0,55);
     display.print("> Wind Level 60%");
    }

  /*prints BME180 pressure in Hectopascal Pressure Unit*/
  /*display.setCursor(0,20);
  display.print("P=");
  display.print(bmp.readPressure()/100.0F,1);
  display.println("hPa"); */
 
  
    /*prints BME180 altitude in meeters*/
  display.setCursor(60,15);
  display.print("| A=");
  display.print(bmp.readAltitude(SEALEVELPRESSURE_HPA),1);
  display.println("m");
  delay(100);
 
 curpressure=bmp.readPressure()/100.0;
 pweather=(101.3*exp(((float)(curalt))/(-7900)));
 simpweadiff=curpressure-pweather;
 display.setCursor(0,28);
 display.print("It's a ");
 if (simpweadiff>0.25)
   display.print("SUNNY");

   if (simpweadiff<=0.25)
   display.print("CLOUDY");
   
  if (simpweadiff<-0.25)
   display.print("RAINY");
   display.println(" Day");
//delay(2000);
//Emergency Auto Break
      digitalWrite(motor2pin1, HIGH);
      digitalWrite(motor2pin2, LOW);
      analogWrite(ENB,motorSpeed6);
  if(cm<30)
     { 
      display.clearDisplay();
      display.setTextSize(1);
      display.setTextColor(WHITE);

      digitalWrite(motor2pin1, LOW);
      digitalWrite(motor2pin2, LOW);
      analogWrite(ENB,motorSpeed0);
      
      display.setCursor(0,10);
      display.print("EMERGENCY     BREAK");
      display.drawBitmap(xx, yy,autobreak,128,64, 1);
      display.display();
      delay(500);
     }
     
   
   display.display();
}

long microsecondsToCentimeters(long microseconds) // method to covert microsec to cm
{
 return microseconds / 29 / 2;
} 
